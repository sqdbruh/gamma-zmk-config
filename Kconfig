## Kconfig
```kconfig
config ZMK_CHECK_BATTERY_BEH
    bool "Enable custom &check_bat implementation"
    help
      When enabled the gamma board (or any board in this module) is
      expected to provide implementations of show_battery() and
      hide_battery(). When disabled the behavior compiles to no-ops.
```

## boards/sqd/gamma/Kconfig.defconfig
```kconfig
# SPDX-License-Identifier: MIT

if BOARD_GAMMA_DONGLE

config BOARD
    default "gamma_dongle"

config ZMK_KEYBOARD_NAME
    default "Gamma"

config ZMK_SPLIT_ROLE_CENTRAL
    default y

config ZMK_USB
    default y

endif # BOARD_GAMMA_DONGLE

if BOARD_GAMMA_LEFT

config BOARD
    default "gamma_left"

config ZMK_KEYBOARD_NAME
    default "Gamma"

config ZMK_SPLIT_ROLE_CENTRAL
    default n

endif # BOARD_GAMMA_LEFT

if BOARD_GAMMA_RIGHT

config BOARD
    default "gamma_right"

config ZMK_KEYBOARD_NAME
    default "Gamma"

config ZMK_SPLIT_ROLE_CENTRAL
    default n

endif # BOARD_GAMMA_RIGHT

if BOARD_GAMMA_LEFT || BOARD_GAMMA_RIGHT || BOARD_GAMMA_DONGLE

config ZMK_BLE
    default y

config ZMK_SPLIT
    default y

config I2C
    default y

config SENSOR
    default y

if USB

config USB_NRFX
    default y

config USB_DEVICE_STACK
    default y

endif # USB

endif # BOARD_GAMMA_LEFT || BOARD_GAMMA_RIGHT || BOARD_GAMMA_DONGLE
```

## boards/sqd/gamma/Kconfig.gamma_dongle
```kconfig
config BOARD_GAMMA_DONGLE
    select SOC_NRF52840_QIAA
    select ZMK_BOARD_COMPAT
```

## boards/sqd/gamma/Kconfig.gamma_left
```kconfig
config BOARD_GAMMA_LEFT
    select SOC_NRF52840_QIAA
    select ZMK_BOARD_COMPAT
```

## boards/sqd/gamma/Kconfig.gamma_right
```kconfig
config BOARD_GAMMA_RIGHT
    select SOC_NRF52840_QIAA
    select ZMK_BOARD_COMPAT
```

## boards/sqd/gamma/board.yml
```yaml
boards:
  - name: gamma_left
    vendor: sqd
    socs:
      - name: nrf52840
  - name: gamma_right
    vendor: sqd
    socs:
      - name: nrf52840
  - name: gamma_dongle
    vendor: sqd
    socs:
      - name: nrf52840
```

## boards/sqd/gamma/gamma_right_defconfig
```kconfig
# SPDX-License-Identifier: MIT

CONFIG_ZMK_KEYBOARD_NAME="Gamma"
CONFIG_ZMK_CHECK_BATTERY_BEH=y

# Essentials
CONFIG_PM_DEVICE=y
CONFIG_ARM_MPU=y
CONFIG_PINCTRL=y
CONFIG_GPIO=y
CONFIG_USE_DT_CODE_PARTITION=y
CONFIG_BUILD_OUTPUT_UF2=y
CONFIG_MPU_ALLOW_FLASH_WRITE=y
CONFIG_NVS=y
CONFIG_SETTINGS_NVS=y
CONFIG_FLASH=y
CONFIG_FLASH_PAGE_LAYOUT=y
CONFIG_FLASH_MAP=y
CONFIG_ZMK_BLE=y

# Split / sleep
CONFIG_ZMK_SPLIT=y
CONFIG_ZMK_SLEEP=n
CONFIG_BT_CTLR_TX_PWR_PLUS_8=y

# Battery
CONFIG_ZMK_BATTERY_REPORTING=y
CONFIG_ZMK_BATTERY_REPORT_INTERVAL=60
CONFIG_BT_BAS=y

# Clock
CONFIG_CLOCK_CONTROL=y
CONFIG_CLOCK_CONTROL_NRF=y
CONFIG_CLOCK_CONTROL_NRF_K32SRC_RC=y
CONFIG_CLOCK_CONTROL_NRF_K32SRC_XTAL=n

# Onboard WS2812 strip + SPI bus (driver auto-selects on DT compat).
CONFIG_LED_STRIP=y
CONFIG_SPI=y

# --- DEBUG: SEGGER RTT logging via J-Link/SWD ---
# Halves have no USB so RTT is the only practical log channel.
# Read with JLinkRTTViewer or `JLinkRTTLogger`.
CONFIG_LOG=y
CONFIG_LOG_MODE_DEFERRED=y
CONFIG_LOG_BUFFER_SIZE=8192
CONFIG_LOG_PROCESS_THREAD_STARTUP_DELAY_MS=0
CONFIG_LOG_PROCESS_THREAD_SLEEP_MS=10
CONFIG_LOG_PROCESS_TRIGGER_THRESHOLD=1
CONFIG_LOG_PRINTK=y
CONFIG_ZMK_LOG_LEVEL_DBG=y
CONFIG_USE_SEGGER_RTT=y
CONFIG_LOG_BACKEND_RTT=y
CONFIG_LOG_BACKEND_RTT_MODE_DROP=y
CONFIG_SEGGER_RTT_BUFFER_SIZE_UP=4096
CONFIG_RTT_CONSOLE=y
CONFIG_DEBUG_THREAD_INFO=y
CONFIG_THREAD_NAME=y
```
