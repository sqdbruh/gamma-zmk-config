## boards/gamma/Kconfig.gamma_dongle
```kconfig
# SPDX-License-Identifier: MIT

config BOARD_GAMMA_DONGLE
    bool "gamma_dongle"
    select SOC_NRF52840_QIAA
```

## boards/gamma/Kconfig.gamma_right
```kconfig
# SPDX-License-Identifier: MIT

config BOARD_GAMMA_RIGHT
    bool "gamma_right"
    select SOC_NRF52840_QIAA
```

## boards/gamma/board.yml
```yaml
boards:
  - name: gamma_left
    vendor: gamma
    socs:
      - name: nrf52840

  - name: gamma_right
    vendor: gamma
    socs:
      - name: nrf52840

  - name: gamma_dongle
    vendor: gamma
    socs:
      - name: nrf52840
```

## boards/gamma/gamma_dongle_defconfig
```kconfig
# Enable MPU
CONFIG_ARM_MPU=y

# Enable GPIO
CONFIG_GPIO=y

# Enable pinctrl
CONFIG_PINCTRL=y

# Place application at &code_partition address
CONFIG_USE_DT_CODE_PARTITION=y

# Generate a .uf2 firmware image
CONFIG_BUILD_OUTPUT_UF2=y

# Enable NVS for settings
CONFIG_MPU_ALLOW_FLASH_WRITE=y
CONFIG_NVS=y
CONFIG_SETTINGS_NVS=y
CONFIG_FLASH=y
CONFIG_FLASH_PAGE_LAYOUT=y
CONFIG_FLASH_MAP=y

# 32 kHz RC oscillator (no external crystal)
CONFIG_CLOCK_CONTROL=y
CONFIG_CLOCK_CONTROL_NRF=y
CONFIG_CLOCK_CONTROL_NRF_K32SRC_RC=y
CONFIG_CLOCK_CONTROL_NRF_K32SRC_XTAL=n

# ZMK core features
CONFIG_ZMK_KEYBOARD_NAME="Gamma"
CONFIG_ZMK_BLE=y
CONFIG_ZMK_USB=y
CONFIG_ZMK_SPLIT=y
CONFIG_ZMK_SPLIT_ROLE_CENTRAL=y
CONFIG_ZMK_SPLIT_BLE_CENTRAL_PERIPHERALS=2
CONFIG_ZMK_SLEEP=n

# BLE TX power boost
CONFIG_BT_CTLR_TX_PWR_PLUS_8=y

# PWM LEDs
CONFIG_PWM=y
```

## boards/gamma/gamma_right_defconfig
```kconfig
# Enable GPIO
CONFIG_GPIO=y

# Enable pinctrl
CONFIG_PINCTRL=y

# Generate a .uf2 firmware image
CONFIG_BUILD_OUTPUT_UF2=y

# Enable NVS for settings
CONFIG_MPU_ALLOW_FLASH_WRITE=y
CONFIG_NVS=y
CONFIG_SETTINGS_NVS=y
CONFIG_FLASH=y
CONFIG_FLASH_PAGE_LAYOUT=y
CONFIG_FLASH_MAP=y

# 32 kHz RC oscillator (no external crystal)
CONFIG_CLOCK_CONTROL=y
CONFIG_CLOCK_CONTROL_NRF=y
CONFIG_CLOCK_CONTROL_NRF_K32SRC_RC=y
CONFIG_CLOCK_CONTROL_NRF_K32SRC_XTAL=n

# ZMK core features
CONFIG_ZMK_KEYBOARD_NAME="Gamma"
CONFIG_ZMK_BLE=y
CONFIG_ZMK_SPLIT=y
CONFIG_ZMK_SLEEP=n


# Battery reporting
CONFIG_ZMK_BATTERY_REPORTING=y
CONFIG_ZMK_BATTERY_REPORT_INTERVAL=60
CONFIG_BT_BAS=y

# LED strip
CONFIG_LED_STRIP=y
CONFIG_WS2812_STRIP_SPI=y
CONFIG_SPI=y

# Optional sensors
CONFIG_I2C=y
CONFIG_SENSOR=y
```

## config/Kconfig
```kconfig
menu "Gamma options"

config GAMMA_LED_TEST
    bool "Gamma LED test"
    default n
    select LED_STRIP
    select WS2812_STRIP_SPI
    select SPI
    help
      Enable simple LED strip test that lights all LEDs white on boot.

config GAMMA_LED_PROBE
    bool "Gamma LED data probe"
    default n
    select GPIO
    depends on !GAMMA_LED_TEST
    help
      Toggle the LED data pin (P0.24) for probing with a multimeter.

endmenu
```

## dts/bindings/behaviors/zmk,behavior-check-battery.yaml
```yaml
# Copyright (c) 2020 The ZMK Contributors
# SPDX-License-Identifier: MIT

description: Show battery info on display

compatible: "zmk,behavior-check-battery"

include: zero_param.yaml
```

## old/gamma/Kconfig
```kconfig
config ZMK_KEYBOARD_NAME
    string "Gamma"

config USB_DEVICE_PRODUCT
    default ZMK_KEYBOARD_NAME

config BT_DEVICE_NAME
    default ZMK_KEYBOARD_NAME
```

## old/gamma/Kconfig.board
```kconfig
# Planck V6 board configuration

# Copyright (c) 2020 The ZMK Contributors
# SPDX-License-Identifier: MIT

config BOARD_GAMMA_DONGLE
    bool "gamma_dongle"
    depends on SOC_NRF52840_QIAA
config BOARD_GAMMA_LEFT
    bool "gamma_left"
    depends on SOC_NRF52840_QIAA
config BOARD_GAMMA_RIGHT
    bool "gamma_right"
    depends on SOC_NRF52840_QIAA
```

## old/gamma/Kconfig.defconfig
```kconfig
# Planck keyboard configuration

# Copyright (c) 2020 The ZMK Contributors
# SPDX-License-Identifier: MIT
if BOARD_GAMMA_DONGLE
    config ZMK_SPLIT_ROLE_CENTRAL
        default y

    config ZMK_USB
        default y
endif

if BOARD_GAMMA_LEFT || BOARD_GAMMA_RIGHT
    config ZMK_SPLIT_ROLE_CENTRAL
        default n
endif

if BOARD_GAMMA_LEFT || BOARD_GAMMA_RIGHT || BOARD_GAMMA_DONGLE

config ZMK_BLE
	default y

config ZMK_SPLIT
    default y

config ZMK_KEYBOARD_NAME
    default "gamma"

config BOARD
    default "gamma"

# Enable I2C and sensor support
config I2C
    default y

config SENSOR
    default y

if USB

config USB_NRFX
    default y

config USB_DEVICE_STACK
    default y

endif # USB

config BT_CTLR
    default BT

endif # BOARD_GAMMA


# if BOARD_GAMMA_LEFT

# 	config ZMK_KEYBOARD_NAME
# 	default "Gamma"

# endif # BOARD_GAMMA_LEFT


# if BOARD_GAMMA_LEFT || BOARD_GAMMA_RIGHT

# config BOARD
# 	default "gamma"

# config ZMK_SPLIT
# 	default y

# config BT_CTLR
# 	default BT


# config ZMK_USB
# 	default y

# if USB

# config USB_NRFX
# 	default y

# config USB_DEVICE_STACK
# 	default y

# endif # USB

# endif # BOARD_GAMMA_LEFT || BOARD_GAMMA_RIGHT
```

## old/gamma/gamma_dongle_defconfig
```kconfig
# SPDX-License-Identifier: MIT

# CONFIG_ZMK_USB_LOGGING=y
# CONFIG_ZMK_STUDIO=y
# BOARD SPECIFIC 
CONFIG_BOARD_GAMMA_DONGLE=y
CONFIG_ZMK_SPLIT_BLE_CENTRAL_PERIPHERALS=2
CONFIG_ZMK_KEYBOARD_NAME="Gamma"
CONFIG_PWM=y

# ESSENTIALS
CONFIG_PM_DEVICE=y
CONFIG_SOC_SERIES_NRF52X=y
CONFIG_SOC_NRF52840_QIAA=y
CONFIG_ARM_MPU=y
CONFIG_PINCTRL=y
CONFIG_GPIO=y
CONFIG_USE_DT_CODE_PARTITION=y
CONFIG_BUILD_OUTPUT_UF2=y
CONFIG_MPU_ALLOW_FLASH_WRITE=y
CONFIG_NVS=y
CONFIG_SETTINGS_NVS=y
CONFIG_FLASH=y
CONFIG_FLASH_PAGE_LAYOUT=y
CONFIG_FLASH_MAP=y
CONFIG_ZMK_BLE=y
CONFIG_ZMK_USB=y

# OPTIONAL
CONFIG_ZMK_SPLIT=y
# NOTE(sqd): This won't sleep anyway because of permanent USB connection.
CONFIG_ZMK_SLEEP=n

CONFIG_BT_CTLR_TX_PWR_PLUS_8=y
# CONFIG_ZMK_BLE_CLEAR_BONDS_ON_START=y
# CONFIG_ZMK_SETTINGS_RESET_ON_START=y
```

## old/gamma/gamma_left_defconfig
```kconfig
# BOARD SPECIFIC 
CONFIG_BOARD_GAMMA_LEFT=y
CONFIG_ZMK_KEYBOARD_NAME="Gamma"
CONFIG_ZMK_CHECK_BATTERY_BEH=y

# ESSENTIALS
CONFIG_PM=y
CONFIG_PM_DEVICE=y
CONFIG_SOC_SERIES_NRF52X=y
CONFIG_SOC_NRF52840_QIAA=y
CONFIG_ARM_MPU=y
CONFIG_PINCTRL=y
CONFIG_GPIO=y
CONFIG_USE_DT_CODE_PARTITION=y
CONFIG_BUILD_OUTPUT_UF2=y
CONFIG_MPU_ALLOW_FLASH_WRITE=y
CONFIG_NVS=y
CONFIG_SETTINGS_NVS=y
CONFIG_FLASH=y
CONFIG_FLASH_PAGE_LAYOUT=y
CONFIG_FLASH_MAP=y
CONFIG_ZMK_BLE=y
CONFIG_ZMK_USB=y

# OPTIONAL
CONFIG_ZMK_SPLIT=y
CONFIG_ZMK_SLEEP=n
CONFIG_BT_CTLR_TX_PWR_PLUS_8=y

# BATTERY
CONFIG_ZMK_BATTERY_REPORTING=y
CONFIG_ZMK_BATTERY_REPORT_INTERVAL=60
CONFIG_BT_BAS=y

CONFIG_CLOCK_CONTROL=y
CONFIG_CLOCK_CONTROL_NRF=y
CONFIG_CLOCK_CONTROL_NRF_K32SRC_RC=y
CONFIG_CLOCK_CONTROL_NRF_K32SRC_XTAL=n

CONFIG_LED_STRIP=y
CONFIG_WS2812_STRIP=y
CONFIG_SPI=y  # If using SPI-based driver

# Enable I2C and sensor support
CONFIG_I2C=y
CONFIG_SENSOR=y

CONFIG_ZMK_USB_LOGGING=y

# CONFIG_ZMK_BLE_CLEAR_BONDS_ON_START=y
# CONFIG_ZMK_SETTINGS_RESET_ON_START=y
```
