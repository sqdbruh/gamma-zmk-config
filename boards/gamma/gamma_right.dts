// This file was generated from a template. Edit it to match your keyboard.
// See https://zmk.dev/docs/development/hardware-integration/new-shield for more
// instructions.

#include "gamma.dtsi"
#include "gamma_right-pinctrl.dtsi"

&default_transform {
    col-offset = <22>;
};
